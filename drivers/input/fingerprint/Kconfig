## drivers/input/fingerprint/Kconfig
```kconfig
config INPUT_FINGERPRINT
	tristate "Fingerprint driver support"
	help
	  Say Y here to enable fingerprint driver support.

if INPUT_FINGERPRINT

config CONFIG_FINGERPRINT_GOODIX_FOD
	tristate "goodix fingerprint fod"
	help 
		say Y to enable fod goodix

endif
```
