/* Copyright (c) 2020, The Linux Foundation. All rights reserved.
*  Copyright (c) 2020, Jebaitedneko.
*
* This program is free software; you can redistribute it and/or modify
* it under the terms of the GNU General Public License version 2 and
* only version 2 as published by the Free Software Foundation.
*
* This program is distributed in the hope that it will be useful,
* but WITHOUT ANY WARRANTY; without even the implied warranty of
* MERCHANTABILITY or FITNESS FOR A PARTICULAR PURPOSE.  See the
* GNU General Public License for more details.
*/

#include "oxygen-general.dtsi"
#include "oxygen-pinctrl.dtsi"
#include "oxygen-audio.dtsi"
#include "oxygen-mdss.dtsi"
#include "oxygen-power.dtsi"
#include "oxygen-camera.dtsi"
